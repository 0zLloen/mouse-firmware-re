## devices/glorious-series-one-pro/zmk-board/boards/glorious/glorious_series_one_pro/Kconfig.defconfig
```kconfig
# SPDX-License-Identifier: MIT

if BOARD_GLORIOUS_SERIES_ONE_PRO

config ZMK_KEYBOARD_NAME
    default "Series One PRO"

if USB

config USB_NRFX
    default y

config USB_DEVICE_STACK
    default y

endif # USB

endif # BOARD_GLORIOUS_SERIES_ONE_PRO
```

## devices/glorious-series-one-pro/zmk-board/boards/glorious/glorious_series_one_pro/Kconfig.glorious_series_one_pro
```kconfig
# SPDX-License-Identifier: MIT

config BOARD_GLORIOUS_SERIES_ONE_PRO
    select SOC_NRF52840_QIAA
    select ZMK_BOARD_COMPAT
```

## devices/glorious-series-one-pro/zmk-board/boards/glorious/glorious_series_one_pro/board.yml
```yaml
board:
  name: glorious_series_one_pro
  full_name: Glorious Series One Pro Wireless (CM2852-BAMF)
  vendor: glorious
  socs:
    - name: nrf52840
```

## devices/glorious-series-one-pro/zmk-board/boards/glorious/glorious_series_one_pro/dts/bindings/glorious,behavior-compx-bootloader.yaml
```yaml
# SPDX-License-Identifier: MIT
description: Write the Compx bootloader magic (0xA55AA55A at 0x2003FFFC) and reset into 258a:2103

compatible: "glorious,behavior-compx-bootloader"

include: zero_param.yaml
```
